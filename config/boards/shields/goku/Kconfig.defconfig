## config/boards/shields/goku/Kconfig.defconfig
```kconfig
# Copyright (c) 2024 Quang Nguyen
# SPDX-License-Identifier: MIT

if SHIELD_GOKU_LEFT

config ZMK_KEYBOARD_NAME
    default "goku"

config ZMK_SPLIT_ROLE_CENTRAL
    default y

endif

if SHIELD_GOKU_LEFT || SHIELD_GOKU_RIGHT
config ZMK_SPLIT
    default y
endif
```

## config/boards/shields/goku/Kconfig.shield
```kconfig
# Copyright (c) 2024 Quang Nguyen
# SPDX-License-Identifier: MIT

config SHIELD_GOKU_LEFT
    def_bool $(shields_list_contains,goku_left)

config SHIELD_GOKU_RIGHT
    def_bool $(shields_list_contains,goku_right)
```
